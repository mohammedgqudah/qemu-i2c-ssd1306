## hw/avr/Kconfig
```kconfig
config AVR_ATMEGA_MCU
    bool
    select AVR_TIMER16
    select AVR_USART
    select AVR_POWER

config ARDUINO
    bool
    default y
    depends on AVR
    select AVR_ATMEGA_MCU
    select UNIMP
	select I2C
	select TWI_I2C
	select SSD1306
```

## rust/hw/Kconfig
```kconfig
# devices Kconfig
source char/Kconfig
source timer/Kconfig
source i2c/Kconfig
source display/Kconfig
```
